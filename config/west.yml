## config/west.yml
```yaml
manifest:
  remotes:
    - name: zmkfirmware
      url-base: https://github.com/zmkfirmware
    - name: ggrocer
      url-base: https://github.com/greengrocer98
  projects:
    - name: zmk
      remote: zmkfirmware
      revision: main
      import: app/west.yml
    - name: zmk-paw3395-driver
      remote: ggrocer
      revision: main
    - name: zmk-vfx-rgdled-indicator
      remote: ggrocer
      revision: main
  self:
    path: config
```
